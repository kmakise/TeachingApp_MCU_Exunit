/**
  ******************************************************************************
  * @file    tim.c
  * @author  张东
  * @version V1.0.0
  * @date    2019-7-17
  * @brief   定时器相关程序
  ******************************************************************************
  */
#include "tim.h"
#include "reg52.h"

TimDataTypedef g_Tim;


/**********************************************************************/
/*							 定时器初始化
/**********************************************************************/
void TIM_Init(void)
{
	TMOD=0x01;	
	TR0=0;	
	ET0=1;			  
	TH0=(65535-9216)/256;	
	TL0=(65535-9216)%256;
	TR0=1;	
}
/**********************************************************************/
/*							 获得时间数据
/**********************************************************************/
TimDataTypedef getTimeData(void)
{
	return g_Tim;
}
/**********************************************************************/
/*							 定时器中断
/**********************************************************************/
void TIM0_Timer() interrupt 1
{
	TH0=(65535-9216)/256;		
	TL0=(65535-9216)%256;
	
	g_Tim.tick++;
	g_Tim.ms10++;
	if(g_Tim.ms10==100)
	{
		g_Tim.ms10=0;
		g_Tim.s++;
		if(g_Tim.s==60)
		{
			g_Tim.s=0;
			g_Tim.m++;
			if(g_Tim.m==60)
			{
				g_Tim.m=0;
				g_Tim.h++;
				if(g_Tim.h==24)
				{
					g_Tim.h=0;
				}
			}
		}
	}
}